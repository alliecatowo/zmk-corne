/*
 * Left half (central) — split input proxy + listener for TPS43 touchpad.
 *
 * No touchpad hardware on this side. The `tps43_split` node is a virtual
 * proxy (reg = <0> matches the right-half forwarder); peripheral input
 * events cross BLE, this proxy re-emits, the listener converts to HID.
 *
 * Axis correction now lives at the driver/chip level (flip-x property on
 * the tps43 node in corne_right.overlay) — chip emits already-correct
 * events. The listener is a pure pass-through; no input-processors.
 */

/ {
    split_inputs {
        #address-cells = <1>;
        #size-cells = <0>;

        tps43_split: tps43_split@0 {
            compatible = "zmk,input-split";
            reg = <0>;
        };
    };

    tps43_listener: tps43_listener {
        compatible = "zmk,input-listener";
        device = <&tps43_split>;
    };
};
